## app/boards/riscv/orangecrab/Kconfig.board
```kconfig
config BOARD_ORANGECRAB
	bool "OrangeCrab with NEORV32 CPU"
	depends on SOC_SERIES_NEORV32
```

## app/boards/riscv/orangecrab/orangecrab_defconfig
```kconfig
CONFIG_SOC_NEORV32=y
CONFIG_SOC_NEORV32_V1_8_6=y
CONFIG_SOC_NEORV32_ISA_C=y
CONFIG_BOARD_ORANGECRAB=y
CONFIG_SERIAL=y
CONFIG_CONSOLE=y
CONFIG_UART_CONSOLE=y
CONFIG_XIP=n

# Workaround for misbehaving UART and mtimer drivers.
# Force sync for both printk and log, we have some problems with task scheduling
# (see mtimer problem described below) which cause messages to be delayed for
# too long and then dropped due to buffer overflow.
CONFIG_PRINTK_SYNC=y
CONFIG_LOG_MODE_MINIMAL=y
# Broken, TX randomly hangs.
CONFIG_UART_INTERRUPT_DRIVEN=n

# FIXME: Seems like there is something wrong with mtimer driver. Zephyr should
# translate hardware clock cycles into to ticks which is Zephyr's representation
# of time, but something bad happens causing Zephyr to hang for indefinitely
# long when sleeping even for 1 ms. As workaround set SYS_CLOCK_TICKS_PER_SEC
# to equal SYS_CLOCK_HW_CYCLES_PER_SEC. This allows Zephyr to proceed.
#
# Note: SYS_CLOCK_HW_CYCLES_PER_SEC is set from DTS
# See SYS_CLOCK_HW_CYCLES_PER_SEC and CONFIG_SYS_CLOCK_TICKS_PER_SEC help for
# details.
CONFIG_SYS_CLOCK_TICKS_PER_SEC=50000000
```

## west.yml
```yaml
manifest:
  self:
    path: twpm-firmware

  defaults:
    remote: upstream

  remotes:
    - name: upstream
      url-base: https://github.com/zephyrproject-rtos

    - name: dasharo
      url-base: https://github.com/Dasharo

    - name: wolfssl
      url-base: https://github.com/wolfssl

  projects:
    - name: zephyr
      revision: 71194e41ac04d74a60d541257d98c20bb6e6bf6d
      remote: dasharo
      path: zephyr
      west-commands: scripts/west-commands.yml

    - name: cmsis
      revision: 74981bf893e8b10931464b9945e2143d99a3f0a3
      path: modules/hal/cmsis
      groups:
        - hal

    - name: hal_espressif
      revision: abe299333411cb37a1cb1dd0aa2ea35c27382604
      path: modules/hal/espressif
      west-commands: west/west-commands.yml
      groups:
        - hal

    - name: hal_stm32
      revision: c865374fc83d93416c0f380e6310368ff55d6ce2
      path: modules/hal/stm32
      groups:
        - hal

    - name: hal_xtensa
      revision: 41a631d4aeeeaedc0daece21eecc338807296ad7
      path: modules/hal/xtensa
      groups:
        - hal

    - name: hal_quicklogic
      revision: b3a66fe6d04d87fd1533a5c8de51d0599fcd08d0
      path: modules/hal/quicklogic
      groups:
        - hal

    - name: ms-tpm-20-ref
      revision: 5878ec1e26bace3960d62468f4740d1c08394f1c
      path: modules/ms-tpm-20-ref
      remote: dasharo

    - name: wolfssl
      path: modules/crypto/wolfssl
      revision: v5.6.3-stable
      remote: wolfssl
```
